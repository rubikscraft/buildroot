## configs/clipgrabber_defconfig
```kconfig
BR2_arm=y
BR2_arm1176jzf_s=y
BR2_TOOLCHAIN_BUILDROOT_GLIBC=y
BR2_PACKAGE_HOST_LINUX_HEADERS_CUSTOM_5_10=y
BR2_PACKAGE_GLIBC_UTILS=y
BR2_BINUTILS_VERSION_2_34_X=y
BR2_TOOLCHAIN_BUILDROOT_CXX=y
BR2_ROOTFS_MERGED_USR=y
BR2_SYSTEM_DEFAULT_PATH="/bin:/sbin:/usr/bin:/usr/sbin"
BR2_TARGET_TZ_INFO=y
BR2_ROOTFS_POST_BUILD_SCRIPT="board/clipgrabber/post-build.sh"
BR2_ROOTFS_POST_IMAGE_SCRIPT="board/clipgrabber/post-image.sh"
BR2_ROOTFS_POST_SCRIPT_ARGS="--add-miniuart-bt-overlay"
BR2_LINUX_KERNEL=y
BR2_LINUX_KERNEL_CUSTOM_TARBALL=y
BR2_LINUX_KERNEL_CUSTOM_TARBALL_LOCATION="$(call github,raspberrypi,linux,967d45b29ca2902f031b867809d72e3b3d623e7a)/linux-967d45b29ca2902f031b867809d72e3b3d623e7a.tar.gz"
BR2_LINUX_KERNEL_DEFCONFIG="bcmrpi"
BR2_LINUX_KERNEL_DTS_SUPPORT=y
BR2_LINUX_KERNEL_INTREE_DTS_NAME="bcm2708-rpi-zero-w"
BR2_LINUX_KERNEL_NEEDS_HOST_OPENSSL=y
BR2_PACKAGE_BUSYBOX_SHOW_OTHERS=y
BR2_PACKAGE_BUSYBOX_WATCHDOG=y
BR2_PACKAGE_CLIPGRAB=y
BR2_PACKAGE_GREP=y
BR2_PACKAGE_RPI_FIRMWARE=y
BR2_PACKAGE_RPI_WIFI_FIRMWARE=y
BR2_PACKAGE_DBUS=y
BR2_PACKAGE_PYTHON3=y
BR2_PACKAGE_PYTHON3_NETSWITCH=y
BR2_PACKAGE_PYTHON_FLASK=y
BR2_PACKAGE_LIBYAML=y
BR2_PACKAGE_C_ARES=y
BR2_PACKAGE_NGHTTP2=y
BR2_PACKAGE_LIBCAP=y
BR2_PACKAGE_LIBUV=y
BR2_PACKAGE_DHCPCD=y
BR2_PACKAGE_DNSMASQ=y
# BR2_PACKAGE_DNSMASQ_TFTP is not set
BR2_PACKAGE_IW=y
BR2_PACKAGE_NBD=y
# BR2_PACKAGE_NBD_CLIENT is not set
BR2_PACKAGE_NTP=y
BR2_PACKAGE_NTP_NTPDATE=y
BR2_PACKAGE_WPA_SUPPLICANT=y
BR2_PACKAGE_WPA_SUPPLICANT_CLI=y
BR2_PACKAGE_WPA_SUPPLICANT_WPA_CLIENT_SO=y
BR2_PACKAGE_WPA_SUPPLICANT_PASSPHRASE=y
BR2_PACKAGE_SCREEN=y
BR2_PACKAGE_HTOP=y
BR2_PACKAGE_KMOD=y
BR2_PACKAGE_KMOD_TOOLS=y
BR2_PACKAGE_UTIL_LINUX=y
BR2_PACKAGE_UTIL_LINUX_AGETTY=y
BR2_PACKAGE_UTIL_LINUX_FSCK=y
BR2_PACKAGE_UTIL_LINUX_MOUNT=y
BR2_PACKAGE_NANO=y
BR2_TARGET_ROOTFS_EXT2=y
BR2_TARGET_ROOTFS_EXT2_4=y
BR2_TARGET_ROOTFS_EXT2_SIZE="200M"
# BR2_TARGET_ROOTFS_TAR is not set
BR2_PACKAGE_HOST_DOSFSTOOLS=y
BR2_PACKAGE_HOST_GENIMAGE=y
BR2_PACKAGE_HOST_MTOOLS=y
```

## package/python-access-points/Config.in
```kconfig
config BR2_PACKAGE_PYTHON_ACCESS_POINTS
	bool "python-access-points"
	help
	  Scan your WiFi and get access point information and signal
	  quality.

	  https://github.com/kootenpv/access_points
```

## package/python-ifcfg/Config.in
```kconfig
config BR2_PACKAGE_PYTHON_IFCFG
	bool "python-ifcfg"
	help
	  Python Ifconfig Wrapper for Unix/Linux/MacOSX.

	  https://github.com/ftao/python-ifcfg
```

## package/python-netswitch/Config.in
```kconfig
config BR2_PACKAGE_PYTHON_NETSWITCH
	bool "python-netswitch"
	select BR2_PACKAGE_PYTHON_ACCESS_POINTS # runtime
	select BR2_PACKAGE_PYTHON_FIRE # runtime
	select BR2_PACKAGE_PYTHON_IFCFG # runtime
	select BR2_PACKAGE_PYTHON_PYSERIAL # runtime
	select BR2_PACKAGE_PYTHON_PYYAML # runtime
	help
	  wifi switching.

	  https://github.com/beasteers/netswitch
```

## package/python3-netswitch/Config.in
```kconfig
config BR2_PACKAGE_PYTHON3_NETSWITCH
	bool "python-netswitch"
	depends on BR2_PACKAGE_PYTHON3
	help
	  Python netswitch
```
